/* CERN Open Hardware Licence -W- V2
 * =============================================================
 * PROXECTO: Controlador Intelixente de Placa Calefactora para soldar/desoldar
 * AUTOR: XDeSIG
 * LICENZA: Código fonte aberto (Open Source)
 * PLATAFORMA: ESP32-C3
 * PANTALLA: OLED SH1107 (128x128)
 * FUNCIONALIDADES:
 *   - Control térmico con termistor NTC 100kΩ
 *   - Axuste de temperatura mediante codificador rotativo
 *   - Controlador P simple estable e seguro
 *   - Gráfico en tempo real da temperatura
 *   - Detección de fallos do sensor (desconexión)
 *   - Corte de emerxencia por sobrecalentamento
 *   - Logo de XDeSIG ao arrancar
 *   - Indicador ON/OFF do calefactor na pantalla principal
 * 
 * Este software é de fonte libre e está deseñado para uso educativo,
 * experimental e persoal. Podes modificar, compartir e mellorar este
 * código libremente, sempre que se recoñeza a autoría orixinal.
 * CERN-OHL-W V2.0
 * 
 * Feito con agarimo en Estrimia
 * =============================================================
 */

#include <Arduino.h>
#include <Wire.h>
#include <Encoder.h>
#include <Adafruit_GFX.h>
#include <Adafruit_SH110X.h>
#include <math.h>

// =============================================================================
// VERSIÓN DO SOFTWARE
// =============================================================================
const char* VERSIÓN_SOFTWARE = "v0.0.1";  // Versión inicial

// =============================================================================
// CONFIGURACIÓN AXUSTABLE POLO USUARIO
// =============================================================================
#define TEMP_MINIMA 20           // Temperatura mínima permitida (°C)
#define TEMP_MAXIMA 300          // Temperatura máxima permitida (°C)
#define PWM_MAX_SAIDA 230        // Potencia máxima do calefactor (0-255)
#define CORTE_EMERXENCIA 301.0f  // Temperatura de corte de seguridade (°C)
#define GANANCIA_KP 1.0f         // Forza de resposta do controlador (P)
#define ALTURA_GRAFICO 64//48        // Altura do gráfico en píxeles
#define ANCHURA_GRAFICO 128      // Anchura do gráfico

// =============================================================================
// DEFINICIÓN DOS PINES DO ESP32-C3
// =============================================================================
#define PIN_SDA_I2C 9
#define PIN_SCL_I2C 10
#define PIN_TERMISTOR 3   // Entrada analóxica do sensor
#define PIN_CALEFACTOR 8  // Saída PWM para o calefactor
#define PIN_COD_ENC_A 6   // Canal A do codificador
#define PIN_COD_ENC_B 7   // Canal B do codificador
#define PIN_COD_SW 5      // Botón do codificador

// =============================================================================
// CONSTANTES FIXAS DO SISTEMA
// =============================================================================
const int PASO_TEMP = 5;
const long ATRASO_ANTIRREbote = 50;
const long INTERVALO_ACTUALIZACION_PANT = 200;
const long INTERVALO_ACTUALIZACION_GRAF = 2500;

// Parámetros do termistor NTC (100kΩ)
const float RESISTENCIA_NOMINAL = 100000.0f;
const float RESISTENCIA_DIVISOR = 32500.0f;
const float BETA_TERMISTOR = 3950.0f;
const float TEMP_NOMINAL = 25.0f;
const float TENSAO_ALIMENTACION = 3.3f;
const float ADC_MAXIMO = 4095.0f;

// =============================================================================
// DECLARACIÓN DO LOGO (definido ao final)
// =============================================================================
extern const unsigned char logo_XDeSIG_128x120[];

// =============================================================================
// VARIABLES GLOBAIS
// =============================================================================
float gananciaKp = GANANCIA_KP;
int temperaturaObxectivo = 230;
float puntoAxuste = temperaturaObxectivo;
float temperaturaActual = 0.0f;
int valorPWM = 0;

bool calefactorActivo = false;
bool controladorActivo = false;

enum EstadoControl { TEMPERATURA_BLOQUEADA,
                     TEMPERATURA_AXUSTE };
EstadoControl estadoActual = TEMPERATURA_AXUSTE;

Adafruit_SH1107 pantalla = Adafruit_SH1107(128, 128, &Wire, -1, 400000);
Encoder codificador(PIN_COD_ENC_A, PIN_COD_ENC_B);

long valorAnteriorCodificador = 0;
unsigned long ultimoPulsoBoton = 0;
bool estadoAnteriorBoton = HIGH;
unsigned long ultimaActualizacionPantalla = 0;
unsigned long ultimaActualizacionGrafico = 0;

float historicoTemperatura[ANCHURA_GRAFICO];
int indiceGrafico = 0;
bool graficoInicializado = false;

// =============================================================================
// FUNCIÓNS
// =============================================================================

float obterTemperatura(int valorADC) {
  if (valorADC <= 0 || valorADC >= ADC_MAXIMO)
    return valorADC <= 0 ? 500.0f : -50.0f;

  float voltaxeSaida = (float)valorADC * (TENSAO_ALIMENTACION / ADC_MAXIMO);
  float resistenciaTermistor = RESISTENCIA_DIVISOR * (voltaxeSaida / (TENSAO_ALIMENTACION - voltaxeSaida));

  float steinhart = log(resistenciaTermistor / RESISTENCIA_NOMINAL) / BETA_TERMISTOR;
  steinhart += 1.0f / (TEMP_NOMINAL + 273.15f);
  steinhart = 1.0f / steinhart - 273.15f;
  return steinhart;
}
// Pantalla de erro
void amosarPantallaErro() {
  pantalla.clearDisplay();
  pantalla.setTextSize(2);
  pantalla.setCursor(20, 20);
  pantalla.print("ERRO de");
  pantalla.setCursor(25, 40);
  pantalla.print("SENSOR!");

  pantalla.setTextSize(1);
  pantalla.setCursor(25, 70);
  pantalla.print("Comproba o");
  pantalla.setCursor(25, 80);
  pantalla.print("termistor.");
  pantalla.display();
}

void actualizarTemperaturaObxectivo(int variacion) {
  temperaturaObxectivo += variacion;
  temperaturaObxectivo = constrain(temperaturaObxectivo, TEMP_MINIMA, TEMP_MAXIMA);
  puntoAxuste = temperaturaObxectivo;
  Serial.print("Temperatura Obxectivo: ");
  Serial.println(temperaturaObxectivo);
}

void xestionarCodificador() {
  long valorActual = codificador.read();
  long variacion = valorActual - valorAnteriorCodificador;

  if (variacion != 0) {
    if (variacion > 0) {
      actualizarTemperaturaObxectivo(PASO_TEMP);
    } else {
      actualizarTemperaturaObxectivo(-PASO_TEMP);
    }
    valorAnteriorCodificador = valorActual;
  }
}

void xestionarBoton() {
  bool estadoActualBoton = digitalRead(PIN_COD_SW);
  unsigned long tempoActual = millis();

  if (estadoActualBoton == LOW && estadoAnteriorBoton == HIGH) {
    if (tempoActual - ultimoPulsoBoton > ATRASO_ANTIRREbote) {
      estadoActual = (estadoActual == TEMPERATURA_AXUSTE) ? TEMPERATURA_BLOQUEADA : TEMPERATURA_AXUSTE;
      controladorActivo = (estadoActual == TEMPERATURA_BLOQUEADA);
      Serial.println(estadoActual == TEMPERATURA_BLOQUEADA ? ">>> ESTADO: BLOQUEADO (CONTROL AUTOMÁTICO)" : ">>> ESTADO: AXUSTE (CONTROL MANUAL)");
      if (estadoActual == TEMPERATURA_AXUSTE) {
        valorAnteriorCodificador = codificador.read();
      }
      ultimoPulsoBoton = tempoActual;
    }
  }
  estadoAnteriorBoton = estadoActualBoton;
}

// Actualiza a pantalla OLED con toda a información
void actualizarPantalla() {
  pantalla.clearDisplay();

  // Título e versión
  pantalla.setTextSize(1);
  pantalla.setCursor(0, 0);
  pantalla.print("Contr.Pl.Quece ");
  pantalla.setCursor(128 - (strlen(VERSIÓN_SOFTWARE) * 6), 0);
  pantalla.print(VERSIÓN_SOFTWARE);

  // Temperatura actual (grande) + estado do calefactor
  pantalla.setTextSize(4);
  pantalla.setCursor(5, 12);
  pantalla.print((int)temperaturaActual);
  pantalla.setTextSize(1);

  // Unidade 'C'
  int lonxTextoTemp = String((int)temperaturaActual).length();
  int posX_C = 5 + (lonxTextoTemp * 24);
  pantalla.setCursor(posX_C, 15);
  pantalla.print("C");

  // Estado do calefactor (ON/OFF) á dereita
  int posX_estado = posX_C + 15;  // 6 píxeles despois do "C"
  pantalla.setTextSize(2);
  pantalla.setCursor(posX_estado, 22);
  int porcentaxe = (int)(valorPWM * 100 / 255);
  pantalla.print(porcentaxe);
  pantalla.print("%");


  // Liña separadora
  pantalla.drawLine(0, 44, 127, 44, SH110X_WHITE);

  // Temperatura obxectivo
  pantalla.setTextSize(2);
  pantalla.setCursor(0, 50);
  pantalla.print("Obx");
  if (estadoActual == TEMPERATURA_AXUSTE) {
    pantalla.setTextColor(SH110X_BLACK, SH110X_WHITE);
  }
  pantalla.setCursor(40, 50);
  pantalla.print(temperaturaObxectivo);
  pantalla.setTextSize(1);
  pantalla.print("c");
  pantalla.setCursor(90, 50);
  if (estadoActual == TEMPERATURA_AXUSTE) {
    pantalla.setTextColor(SH110X_WHITE, SH110X_BLACK);
    pantalla.setTextSize(2);
    pantalla.print("OFF");
  } else {
    pantalla.setTextSize(2);
    pantalla.print(" ON");
  }


  // Debuxa o gráfico de temperatura na parte inferior
  if (graficoInicializado) {
    const int desprazamentoY = 128 - ALTURA_GRAFICO;
    pantalla.fillRect(0, desprazamentoY, ANCHURA_GRAFICO, ALTURA_GRAFICO, SH110X_BLACK);

    const float tempMin = 0.0f;
    const float tempMax = 400.0f;
    const float rangoTemp = tempMax - tempMin;

    // Debuxa a curva de temperatura actual
    for (int x = 0; x < ANCHURA_GRAFICO; x++) {
      int indiceBuffer = (indiceGrafico + x) % ANCHURA_GRAFICO;
      float temp = historicoTemperatura[indiceBuffer];
      if (temp < tempMin) temp = tempMin;
      if (temp > tempMax) temp = tempMax;

      int y = desprazamentoY + (int)(ALTURA_GRAFICO - (temp - tempMin) * ALTURA_GRAFICO / rangoTemp);
      pantalla.drawPixel(x, y, SH110X_WHITE);
    }

    // Debuxa a liña do obxectivo con puntos separados (máis visible)
    if (temperaturaObxectivo >= tempMin && temperaturaObxectivo <= tempMax) {
      int yObxectivo = desprazamentoY + (int)(ALTURA_GRAFICO - (temperaturaObxectivo - tempMin) * ALTURA_GRAFICO / rangoTemp);
      for (int x = 0; x < ANCHURA_GRAFICO; x += 4) {
        pantalla.drawPixel(x, yObxectivo, SH110X_WHITE);
        pantalla.drawPixel(x + 1, yObxectivo, SH110X_WHITE);
      }
    }
  }

  pantalla.display();  // Mostra a pantalla (actualiza)
}
// =============================================================================
// SETUP
// =============================================================================
void setup() {
  Serial.begin(115200);

  Wire.begin(PIN_SDA_I2C, PIN_SCL_I2C);
  pantalla.begin(0x3C, true);
  pantalla.setRotation(3);
  pantalla.setTextColor(SH110X_WHITE);

  // Amosa o logo de XDeSIG durante 2 segundos
  pantalla.clearDisplay();
  pantalla.drawBitmap(0, 4, logo_XDeSIG_128x120, 128, 120, SH110X_WHITE);
  pantalla.display();
  delay(2000);

  pantalla.clearDisplay();
  pantalla.display();

  pinMode(PIN_COD_SW, INPUT_PULLUP);
  if (!ledcAttach(PIN_CALEFACTOR, 5000, 8)) {
    Serial.println("ERRO: Non se puido configurar o PWM!");
  }

  analogReadResolution(12);
  analogSetAttenuation(ADC_11db);

  valorAnteriorCodificador = codificador.read();
  Serial.println("Sistema v2.3.1 - XDeSIG");
}

// =============================================================================
// LOOP
// =============================================================================
void loop() {
  unsigned long tempoActual = millis();

  xestionarBoton();
  if (estadoActual == TEMPERATURA_AXUSTE) {
    xestionarCodificador();
  }

  int totalAdc = 0;
  for (int i = 0; i < 10; i++) {
    totalAdc += analogRead(PIN_TERMISTOR);
  }
  temperaturaActual = obterTemperatura(totalAdc / 10);

  // --- DETECCIÓN DE ERRO DO SENSOR ---
  if (temperaturaActual <= -49.0f) {
    valorPWM = 0;
    calefactorActivo = false;
    controladorActivo = false;
    estadoActual = TEMPERATURA_AXUSTE;
    ledcWrite(PIN_CALEFACTOR, 0);  // Apaga o triac inmediatamente
    amosarPantallaErro();
    delay(1000);
    return;
  }

  // CORTE DE EMERXENCIA
  if (temperaturaActual > CORTE_EMERXENCIA) {
    valorPWM = 0;
    controladorActivo = false;
    estadoActual = TEMPERATURA_AXUSTE;
    Serial.println("!!! CORTE DE EMERXENCIA: T > " + String(CORTE_EMERXENCIA) + "°C !!!");
  }

  // CONTROLADOR P SIMPLE
  if (controladorActivo) {
    float erro = puntoAxuste - temperaturaActual;
    valorPWM = (int)(gananciaKp * erro);
    if (valorPWM < 0) valorPWM = 0;
    if (valorPWM > PWM_MAX_SAIDA) valorPWM = PWM_MAX_SAIDA;
    calefactorActivo = (valorPWM > 0);
  } else {
    valorPWM = 0;
    calefactorActivo = false;
  }

  ledcWrite(PIN_CALEFACTOR, (uint32_t)valorPWM);

  Serial.print("T: ");
  Serial.print(temperaturaActual, 1);
  Serial.print("C | Obx: ");
  Serial.print(temperaturaObxectivo);
  Serial.print("C | PWM: ");
  Serial.println(valorPWM);

  if (tempoActual - ultimaActualizacionPantalla >= INTERVALO_ACTUALIZACION_PANT) {
    actualizarPantalla();
    ultimaActualizacionPantalla = tempoActual;
  }

  if (tempoActual - ultimaActualizacionGrafico >= INTERVALO_ACTUALIZACION_GRAF) {
    historicoTemperatura[indiceGrafico] = temperaturaActual;
    indiceGrafico = (indiceGrafico + 1) % ANCHURA_GRAFICO;
    graficoInicializado = true;
    ultimaActualizacionGrafico = tempoActual;
  }
}

// =============================================================================
// LOGO XDeSIG - 128x120 px
// =============================================================================
const unsigned char PROGMEM logo_XDeSIG_128x120[] = {
  // 'Xdesig_128', 128x120px
  0x00, 0x03, 0xff, 0xff, 0x00, 0x00, 0x00, 0x00, 0x00, 0x00, 0x00, 0x00, 0x7f, 0xff, 0x80, 0x00,
  0x00, 0x01, 0xff, 0xff, 0x80, 0x00, 0x00, 0x00, 0x00, 0x00, 0x00, 0x00, 0xff, 0xff, 0x80, 0x00,
  0x00, 0x01, 0xff, 0xff, 0xc0, 0x00, 0x00, 0x00, 0x00, 0x00, 0x00, 0x00, 0xff, 0xff, 0x00, 0x00,
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  0x00, 0x7f, 0xff, 0xe0, 0x00, 0x00, 0x00, 0x00, 0x00, 0x00, 0x00, 0x00, 0x3f, 0xff, 0xf8, 0x00
};